## esp_system/Kconfig.projbuild
```kconfig
config ESP_SYSTEM_SINGLE_CORE_MODE
    bool
    default n
config ESP_SYSTEM_RTC_EXT_XTAL
    # This is a High Layer Kconfig option, invisible, can be selected by other Kconfig option
    # e.g. It will be selected on when RTC_CLK_SRC_EXT_CRYS is on
    bool
    default n

config ESP_SYSTEM_RTC_EXT_OSC
    # This is a High Layer Kconfig option, invisible, can be selected by other Kconfig option
    # e.g. It will be selected on when ESPX_RTC_CLK_SRC_EXT_OSC is on
    bool
    default n

# vfs related
config VFS_SUPPORT_IO
    bool
    default y
config VFS_SUPPORT_DIR
    bool
    default y
config VFS_SUPPORT_SELECT
    bool
    default y
config VFS_SUPPRESS_SELECT_DEBUG_OUTPUT
    bool
    default y
config VFS_SUPPORT_TERMIOS
    bool
    default y
config VFS_SEMIHOSTFS_MAX_MOUNT_POINTS
    # do not how
    int
    default 1

menu "ESP System Settings"
    rsource "driver/$IDF_TARGET/Kconfig.cpu"
    rsource "driver/$IDF_TARGET/Kconfig.cache"

    choice ESP_SYSTEM_LOG_LEVEL
        bool "Bootloader log verbosity"
        default ESP_SYSTEM_LOG_LEVEL_DEBUG

        config ESP_SYSTEM_LOG_LEVEL_NONE
            bool "No output"
        config ESP_SYSTEM_LOG_LEVEL_ERROR
            bool "Error"
        config ESP_SYSTEM_LOG_LEVEL_WARN
            bool "Warning"
        config ESP_SYSTEM_LOG_LEVEL_INFO
            bool "Info"
        config ESP_SYSTEM_LOG_LEVEL_DEBUG
            bool "Debug"
        # config ESP_SYSTEM_LOG_LEVEL_VERBOSE   no verbose logs for bootloader
        #     bool "Verbose"
    endchoice

    config ESP_SYSTEM_LOG_LEVEL
        int
        default 0 if ESP_SYSTEM_LOG_LEVEL_NONE
        default 1 if ESP_SYSTEM_LOG_LEVEL_ERROR
        default 2 if ESP_SYSTEM_LOG_LEVEL_WARN
        default 3 if ESP_SYSTEM_LOG_LEVEL_INFO
        default 4 if ESP_SYSTEM_LOG_LEVEL_DEBUG
        default 5 if ESP_SYSTEM_LOG_LEVEL_VERBOSE

    config ESP_SYSTEM_RTC_FAST_MEM_AS_HEAP_DEPCHECK
        bool
        default y if IDF_TARGET_ESP32 && FREERTOS_UNICORE
        default y if IDF_TARGET_ESP32S2
        default y if IDF_TARGET_ESP32C3
        default y if IDF_TARGET_ESP32S3
        default y if IDF_TARGET_ESP32H4
        default y if IDF_TARGET_ESP32C6
        default y if IDF_TARGET_ESP32H2
        depends on !IDF_TARGET_ESP32C2

    config ESP_SYSTEM_ALLOW_RTC_FAST_MEM_AS_HEAP
        bool "Enable RTC fast memory for dynamic allocations"
        default y
        depends on ESP_SYSTEM_RTC_FAST_MEM_AS_HEAP_DEPCHECK
        help
            This config option allows to add RTC fast memory region to system heap with capability
            similar to that of DRAM region but without DMA. This memory will be consumed first per
            heap initialization order by early startup services and scheduler related code. Speed
            wise RTC fast memory operates on APB clock and hence does not have much performance impact.

    config ESP_SYSTEM_EVENT_QUEUE_SIZE
        int "System event queue size"
        default 32
        help
            Config system event queue size in different application.

    config ESP_SYSTEM_EVENT_TASK_STACK_SIZE
        int "Event loop task stack size"
        default 2304
        help
            Config system event task stack size in different application.

    config ESP_MAIN_TASK_STACK_SIZE
        int "Main task stack size"
        default 3584
        help
            Configure the "main task" stack size. This is the stack of the task
            which calls main(). If main() returns then this task is deleted
            and its stack memory is freed.

    choice ESP_MAIN_TASK_AFFINITY
        prompt "Main task core affinity"
        default ESP_MAIN_TASK_AFFINITY_NO_AFFINITY
        help
            Configure the "main task" core affinity. This is the used core of the task
            which calls main(). If main() returns then this task is deleted.

        config ESP_MAIN_TASK_AFFINITY_CPU0
            bool "CPU0"
        config ESP_MAIN_TASK_AFFINITY_CPU1
            bool "CPU1"
            depends on !FREERTOS_UNICORE
        config ESP_MAIN_TASK_AFFINITY_NO_AFFINITY
            bool "No affinity"
    endchoice

    config ESP_MAIN_TASK_AFFINITY
        hex
        default 0x0 if ESP_MAIN_TASK_AFFINITY_CPU0
        default 0x1 if ESP_MAIN_TASK_AFFINITY_CPU1
        default FREERTOS_NO_AFFINITY if ESP_MAIN_TASK_AFFINITY_NO_AFFINITY
endmenu
```
