## esp_common/Kconfig.projbuild
```kconfig
menu "Newlib"
    choice NEWLIB_STDOUT_LINE_ENDING
        prompt "Line ending for UART output"
        default NEWLIB_STDOUT_LINE_ENDING_CRLF
        help
            This option allows configuring the desired line endings sent to UART
            when a newline ('\n', LF) appears on stdout.
            Three options are possible:

            CRLF: whenever LF is encountered, prepend it with CR

            LF: no modification is applied, stdout is sent as is

            CR: each occurence of LF is replaced with CR

            This option doesn't affect behavior of the UART driver (drivers/uart.h).

        config NEWLIB_STDOUT_LINE_ENDING_CRLF
            bool "CRLF"
        config NEWLIB_STDOUT_LINE_ENDING_LF
            bool "LF"
        config NEWLIB_STDOUT_LINE_ENDING_CR
            bool "CR"
    endchoice

    choice NEWLIB_STDIN_LINE_ENDING
        prompt "Line ending for UART input"
        default NEWLIB_STDIN_LINE_ENDING_CR
        help
            This option allows configuring which input sequence on UART produces
            a newline ('\n', LF) on stdin.
            Three options are possible:

            CRLF: CRLF is converted to LF

            LF: no modification is applied, input is sent to stdin as is

            CR: each occurence of CR is replaced with LF

            This option doesn't affect behavior of the UART driver (drivers/uart.h).

        config NEWLIB_STDIN_LINE_ENDING_CRLF
            bool "CRLF"
        config NEWLIB_STDIN_LINE_ENDING_LF
            bool "LF"
        config NEWLIB_STDIN_LINE_ENDING_CR
            bool "CR"
    endchoice

    config NEWLIB_NANO_FORMAT
        bool "Enable 'nano' formatting options for printf/scanf family"
        default y if IDF_TARGET_ESP32C2
        help
            ESP32 ROM contains parts of newlib C library, including printf/scanf family
            of functions. These functions have been compiled with so-called "nano"
            formatting option. This option doesn't support 64-bit integer formats and C99
            features, such as positional arguments.

            For more details about "nano" formatting option, please see newlib readme file,
            search for '--enable-newlib-nano-formatted-io':
            https://sourceware.org/newlib/README

            If this option is enabled, build system will use functions available in
            ROM, reducing the application binary size. Functions available in ROM run
            faster than functions which run from flash. Functions available in ROM can
            also run when flash instruction cache is disabled.

            If you need 64-bit integer formatting support or C99 features, keep this
            option disabled.

    choice NEWLIB_TIME_SYSCALL
        prompt "Timers used for gettimeofday function"
        default NEWLIB_TIME_SYSCALL_USE_RTC_HRT
        help
            This setting defines which hardware timers are used to
            implement 'gettimeofday' and 'time' functions in C library.

            - If both high-resolution (systimer for all targets except ESP32)
                and RTC timers are used, timekeeping will continue in deep sleep.
                Time will be reported at 1 microsecond resolution.
                This is the default, and the recommended option.
            - If only high-resolution timer (systimer) is used, gettimeofday will
                provide time at microsecond resolution.
                Time will not be preserved when going into deep sleep mode.
            - If only RTC timer is used, timekeeping will continue in
                deep sleep, but time will be measured at 6.(6) microsecond
                resolution. Also the gettimeofday function itself may take
                longer to run.
            - If no timers are used, gettimeofday and time functions
                return -1 and set errno to ENOSYS.
            - When RTC is used for timekeeping, two RTC_STORE registers are
                used to keep time in deep sleep mode.

        config NEWLIB_TIME_SYSCALL_USE_RTC_HRT
            bool "RTC and high-resolution timer"
            select ESP_TIME_FUNCS_USE_RTC_TIMER
            select ESP_TIME_FUNCS_USE_ESP_TIMER
        config NEWLIB_TIME_SYSCALL_USE_RTC
            bool "RTC"
            select ESP_TIME_FUNCS_USE_RTC_TIMER
        config NEWLIB_TIME_SYSCALL_USE_HRT
            bool "High-resolution timer"
            select ESP_TIME_FUNCS_USE_ESP_TIMER
        config NEWLIB_TIME_SYSCALL_USE_NONE
            bool "None"
            select ESP_TIME_FUNCS_USE_NONE
    endchoice

    menu "PThreads"
        config PTHREAD_TASK_PRIO_DEFAULT
            int "Default task priority"
            range 0 255
            default 5
            help
                Priority used to create new tasks with default pthread parameters.

        config PTHREAD_TASK_STACK_SIZE_DEFAULT
            int "Default task stack size"
            default 3072
            help
                Stack size used to create new tasks with default pthread parameters.

        config PTHREAD_STACK_MIN
            int "Minimum allowed pthread stack size"
            default 768
            help
                Minimum allowed pthread stack size set in attributes passed to pthread_create

        choice PTHREAD_TASK_CORE_DEFAULT
            bool "Default pthread core affinity"
            default PTHREAD_DEFAULT_CORE_NO_AFFINITY
            depends on !FREERTOS_UNICORE
            help
                The default core to which pthreads are pinned.

            config PTHREAD_DEFAULT_CORE_NO_AFFINITY
                bool "No affinity"
            config PTHREAD_DEFAULT_CORE_0
                bool "Core 0"
            config PTHREAD_DEFAULT_CORE_1
                bool "Core 1"
        endchoice

        config PTHREAD_TASK_CORE_DEFAULT
            int
            default -1 if PTHREAD_DEFAULT_CORE_NO_AFFINITY || FREERTOS_UNICORE
            default 0 if PTHREAD_DEFAULT_CORE_0
            default 1 if PTHREAD_DEFAULT_CORE_1

        config PTHREAD_TASK_NAME_DEFAULT
            string "Default name of pthreads"
            default "pthread"
            help
                The default name of pthreads.
    endmenu
endmenu
```

## esp_hw_support/Kconfig
```kconfig
menu "Hardware Settings"
    orsource "./port/$IDF_TARGET/Kconfig.spiram"

    menu "MAC Config"
        config ESP_MAC_ADDR_UNIVERSE_WIFI_STA
            bool

        config ESP_MAC_ADDR_UNIVERSE_WIFI_AP
            bool

        config ESP_MAC_ADDR_UNIVERSE_BT
            bool

        config ESP_MAC_ADDR_UNIVERSE_ETH
            bool

        config ESP_MAC_ADDR_UNIVERSE_IEEE802154
            bool

        config ESP_MAC_UNIVERSAL_MAC_ADDRESSES_ONE
            bool

        config ESP_MAC_UNIVERSAL_MAC_ADDRESSES_TWO
            bool

        config ESP_MAC_UNIVERSAL_MAC_ADDRESSES_FOUR
            bool

            # Insert chip-specific MAC config
        orsource "./port/$IDF_TARGET/Kconfig.mac"
    endmenu

    menu "Sleep Config"
        # This is here since this option affect behavior of esp_light_sleep_start
        # regardless of power management configuration.
        config ESP_SLEEP_POWER_DOWN_FLASH
            bool "Power down flash in light sleep when there is no SPIRAM"
            depends on !SPIRAM
            default n
            help
                If enabled, chip will try to power down flash as part of esp_light_sleep_start(), which costs
                more time when chip wakes up. Can only be enabled if there is no SPIRAM configured.

                This option will power down flash under a strict but relatively safe condition. Also, it is possible to
                power down flash under a relaxed condition by using esp_sleep_pd_config() to set ESP_PD_DOMAIN_VDDSDIO
                to ESP_PD_OPTION_OFF. It should be noted that there is a risk in powering down flash, you can refer
                `ESP-IDF Programming Guide/API Reference/System API/Sleep Modes/Power-down of Flash` for more details.

        config ESP_SLEEP_RTC_BUS_ISO_WORKAROUND
            bool
            default y if IDF_TARGET_ESP32 || IDF_TARGET_ESP32S2 || IDF_TARGET_ESP32S3

        config ESP_SLEEP_GPIO_RESET_WORKAROUND
            bool "light sleep GPIO reset workaround"
            default y if IDF_TARGET_ESP32C2 || IDF_TARGET_ESP32C3 || IDF_TARGET_ESP32S3 # TODO: IDF-5641 (esp32c6)
            select PM_SLP_DISABLE_GPIO if FREERTOS_USE_TICKLESS_IDLE
            help
                esp32c2, esp32c3 and esp32s3 will reset at wake-up if GPIO is received a small electrostatic
                pulse during light sleep, with specific condition

                - GPIO needs to be configured as input-mode only
                - The pin receives a small electrostatic pulse, and reset occurs when the pulse
                  voltage is higher than 6 V

                For GPIO set to input mode only, it is not a good practice to leave it open/floating,
                The hardware design needs to controlled it with determined supply or ground voltage
                is necessary.

                This option provides a software workaround for this issue. Configure to isolate all
                GPIO pins in sleep state.

        config ESP_SLEEP_PSRAM_LEAKAGE_WORKAROUND
            bool "PSRAM leakage current workaround in light sleep"
            depends on SPIRAM
            default y
            help
                When the CS pin of SPIRAM is not pulled up, the sleep current will
                increase during light sleep. If the CS pin of SPIRAM has an external
                pull-up, you do not need to select this option, otherwise, you
                should enable this option.

        config ESP_SLEEP_FLASH_LEAKAGE_WORKAROUND
            bool "Flash leakage current workaround in light sleep"
            default y
            help
                When the CS pin of Flash is not pulled up, the sleep current will
                increase during light sleep. If the CS pin of Flash has an external
                pull-up, you do not need to select this option, otherwise, you
                should enable this option.

        config ESP_SLEEP_MSPI_NEED_ALL_IO_PU
            bool "All pins of mspi need pull up"
            depends on ESP_SLEEP_PSRAM_LEAKAGE_WORKAROUND || ESP_SLEEP_FLASH_LEAKAGE_WORKAROUND
            default y if IDF_TARGET_ESP32C2 || IDF_TARGET_ESP32S3
            help
                To reduce leakage current, some types of SPI Flash/RAM only need to pull up the CS pin
                during light sleep. But there are also some kinds of SPI Flash/RAM that need to pull up
                all pins. It depends on the SPI Flash/RAM chip used.

        config ESP_SLEEP_DEEP_SLEEP_WAKEUP_DELAY
            int "Extra delay in deep sleep wake stub (in us)"
            depends on IDF_TARGET_ESP32 || IDF_TARGET_ESP32S3
            default 2000
            range 0 5000
            help
                When the chip exits deep sleep, the CPU and the flash chip are powered on
                at the same time. CPU will run deep sleep stub first, and then
                proceed to load code from flash. Some flash chips need sufficient
                time to pass between power on and first read operation. By default,
                without any extra delay, this time is approximately 900us, although
                some flash chip types need more than that.

                By default extra delay is set to 2000us. When optimizing startup time
                for applications which require it, this value may be reduced.

                If you are seeing "flash read err, 1000" message printed to the
                console after deep sleep reset, try increasing this value.
    endmenu

    menu "RTC Clock Config"
        orsource "./port/$IDF_TARGET/Kconfig.rtc"
    endmenu

    menu "GDMA Configuration"
        depends on SOC_GDMA_SUPPORTED
        config GDMA_CTRL_FUNC_IN_IRAM
            bool "Place GDMA control functions into IRAM"
            default n
            help
                Place GDMA control functions (like start/stop/append/reset) into IRAM,
                so that these functions can be IRAM-safe and able to be called in the other IRAM interrupt context.
                Enabling this option can improve driver performance as well.

        config GDMA_ISR_IRAM_SAFE
            bool "GDMA ISR IRAM-Safe"
            default n
            help
                This will ensure the GDMA interrupt handler is IRAM-Safe, allow to avoid flash
                cache misses, and also be able to run whilst the cache is disabled.
                (e.g. SPI Flash write).
    endmenu # GDMA Configuration
endmenu
```
