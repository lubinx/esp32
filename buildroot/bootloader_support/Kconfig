## freertos/Kconfig.projbuild
```kconfig
config FREERTOS_SMP
    bool
    default "y"

config FREERTOS_UNICORE
    bool
    default "n"

config FREERTOS_NO_AFFINITY
    hex
    default 0xFFFFFFFF

config FREERTOS_SUPPORT_STATIC_ALLOCATION
    # Always enabled. Kconfig option preserved for compatibility with code which checked for
    bool
    default y

menu "FreeRTOS"
    config FREERTOS_HZ
        # Todo: Rename to CONFIG_FREERTOS_TICK_RATE_HZ (IDF-4986)
        int "configTICK_RATE_HZ"
        range 1 1000
        default 100
        help
            Sets the FreeRTOS tick interrupt frequency in Hz (see configTICK_RATE_HZ documentation for more
            details).

    choice FREERTOS_CHECK_STACKOVERFLOW
        prompt "configCHECK_FOR_STACK_OVERFLOW"
        default FREERTOS_CHECK_STACKOVERFLOW_CANARY
        help
            Enables FreeRTOS to check for stack overflows (see configCHECK_FOR_STACK_OVERFLOW documentation for
            more details).
            Note: If users do not provide their own ``vApplicationStackOverflowHook()`` function, a default
            function will be provided by ESP-IDF.

        config FREERTOS_CHECK_STACKOVERFLOW_NONE
            bool "No checking"
            help
                Do not check for stack overflows (configCHECK_FOR_STACK_OVERFLOW = 0)

        config FREERTOS_CHECK_STACKOVERFLOW_PTRVAL
            bool "Check by stack pointer value (Method 1)"
            help
                Check for stack overflows on each context switch by checking if the stack pointer is in a valid
                range. Quick but does not detect stack overflows that happened between context switches
                (configCHECK_FOR_STACK_OVERFLOW = 1)

        config FREERTOS_CHECK_STACKOVERFLOW_CANARY
            bool "Check using canary bytes (Method 2)"
            help
                Places some magic bytes at the end of the stack area and on each context switch, check if these
                bytes are still intact. More thorough than just checking the pointer, but also slightly slower.
                (configCHECK_FOR_STACK_OVERFLOW = 2)
    endchoice

    config FREERTOS_THREAD_LOCAL_STORAGE_POINTERS
        int "configNUM_THREAD_LOCAL_STORAGE_POINTERS"
        range 1 256
        default 1
        help
            Set the number of thread local storage pointers in each task (see
            configNUM_THREAD_LOCAL_STORAGE_POINTERS documentation for more details).

            Note: In ESP-IDF, this value must be at least 1. Index 0 is reserved for use by the pthreads API
            thread-local-storage. Other indexes can be used for any desired purpose.

    config FREERTOS_IDLE_TASK_STACKSIZE
        int "configMINIMAL_STACK_SIZE (Idle task stack size)"
        range 768 32768
        default 768
        help
            Sets the idle task stack size in bytes (see configMINIMAL_STACK_SIZE documentation for more details).
            Note:
            - ESP-IDF specifies stack sizes in bytes instead of words.
            - The default size is enough for most use cases.
            - The stack size may need to be increased above the default if the app installs idle or thread local
                storage cleanup hooks that use a lot of stack memory.
            - Conversely, the stack size can be reduced to the minimum if non of the idle features are used.

    config FREERTOS_MAX_TASK_NAME_LEN
        int "configMAX_TASK_NAME_LEN"
        range 1 256
        default 16
        help
            Sets the maximum number of characters for task names (see configMAX_TASK_NAME_LEN documentation for
            more details).
            Note: For most uses, the default of 16 characters is sufficient.

    config FREERTOS_ENABLE_BACKWARD_COMPATIBILITY
        bool "configENABLE_BACKWARD_COMPATIBILITY"
        default n
        help
            Enable backward compatibility with APIs prior to FreeRTOS v8.0.0. (see
            configENABLE_BACKWARD_COMPATIBILITY documentation for more details).

    config FREERTOS_TIMER_TASK_PRIORITY
        int "configTIMER_TASK_PRIORITY"
        range 1 25
        default 1
        help
            Sets the timer task's priority (see configTIMER_TASK_PRIORITY documentation for more details).

    config FREERTOS_TIMER_TASK_STACK_DEPTH
        int "configTIMER_TASK_STACK_DEPTH"
        range 1536 32768
        default 2053 if IDF_TARGET_LINUX
        default 2048
        help
            Set the timer task's stack size (see configTIMER_TASK_STACK_DEPTH documentation for more details).

    config FREERTOS_TIMER_QUEUE_LENGTH
        int "configTIMER_QUEUE_LENGTH"
        range 5 20
        default 10
        help
            Set the timer task's command queue length (see configTIMER_QUEUE_LENGTH documentation for more
            details).

    config FREERTOS_QUEUE_REGISTRY_SIZE
        int "configQUEUE_REGISTRY_SIZE"
        range 0 20
        default 0
        help
            Set the size of the queue registry (see configQUEUE_REGISTRY_SIZE documentation for more details).

            Note: A value of 0 will disable queue registry functionality

    config FREERTOS_TASK_NOTIFICATION_ARRAY_ENTRIES
        int "configTASK_NOTIFICATION_ARRAY_ENTRIES"
        range 1 32
        default 1
        help
            Set the size of the task notification array of each task. When increasing this value, keep in
            mind that this means additional memory for each and every task on the system.
            However, task notifications in general are more light weight compared to alternatives
            such as semaphores.

    config FREERTOS_USE_TRACE_FACILITY
        bool "configUSE_TRACE_FACILITY"
        default n
        help
            Enables additional structure members and functions to assist with execution visualization and tracing
            (see configUSE_TRACE_FACILITY documentation for more details).

    config FREERTOS_USE_STATS_FORMATTING_FUNCTIONS
        bool "configUSE_STATS_FORMATTING_FUNCTIONS"
        depends on FREERTOS_USE_TRACE_FACILITY
        default n
        help
            Set configUSE_TRACE_FACILITY and configUSE_STATS_FORMATTING_FUNCTIONS to 1 to include the
            ``vTaskList()`` and ``vTaskGetRunTimeStats()`` functions in the build (see
            configUSE_STATS_FORMATTING_FUNCTIONS documentation for more details).

    config FREERTOS_USE_TICKLESS_IDLE
        # Todo: Currently not supported in SMP FreeRTOS yet (IDF-4986)
        # Todo: Consider whether this option should still be exposed (IDF-4986)
        bool "configUSE_TICKLESS_IDLE"
        depends on PM_ENABLE
        default n
        help
            If power management support is enabled, FreeRTOS will be able to put the system into light sleep mode
            when no tasks need to run for a number of ticks. This number can be set using
            FREERTOS_IDLE_TIME_BEFORE_SLEEP option. This feature is also known as "automatic light sleep".

            Note that timers created using esp_timer APIs may prevent the system from entering sleep mode, even
            when no tasks need to run. To skip unnecessary wake-up initialize a timer with the
            "skip_unhandled_events" option as true.

            If disabled, automatic light sleep support will be disabled.

    config FREERTOS_IDLE_TIME_BEFORE_SLEEP
        # Todo: Rename to CONFIG_FREERTOS_EXPECTED_IDLE_TIME_BEFORE_SLEEP (IDF-4986)
        int "configEXPECTED_IDLE_TIME_BEFORE_SLEEP"
        depends on FREERTOS_USE_TICKLESS_IDLE
        default 3
        range 2 4294967295
        # Minimal value is 2 because of a check in FreeRTOS.h (search configEXPECTED_IDLE_TIME_BEFORE_SLEEP)
        help
            FreeRTOS will enter light sleep mode if no tasks need to run for this number of ticks.

    menu "Port"
        # ESP-IDF FreeRTOS port configurations go here (and HW configurations related to FreeRTOS)
        config FREERTOS_TASK_FUNCTION_WRAPPER
            bool "Wrap task functions"
            depends on COMPILER_OPTIMIZATION_DEFAULT || ESP_COREDUMP_ENABLE || ESP_GDBSTUB_ENABLED
            default y
            help
                If enabled, all FreeRTOS task functions will be enclosed in a wrapper function. If a task function
                mistakenly returns (i.e. does not delete), the call flow will return to the wrapper function. The
                wrapper function will then log an error and abort the application. This option is also required for GDB
                backtraces and C++ exceptions to work correctly inside top-level task functions.

        config FREERTOS_WATCHPOINT_END_OF_STACK
            bool "Enable stack overflow debug watchpoint"
            default n
            help
                FreeRTOS can check if a stack has overflown its bounds by checking either the value of the stack
                pointer or by checking the integrity of canary bytes. (See FREERTOS_CHECK_STACKOVERFLOW for more
                information.) These checks only happen on a context switch, and the situation that caused the stack
                overflow may already be long gone by then. This option will use the last debug memory watchpoint to
                allow breaking into the debugger (or panic'ing) as soon as any of the last 32 bytes on the stack of a
                task are overwritten. The side effect is that using gdb, you effectively have one hardware watchpoint
                less because the last one is overwritten as soon as a task switch happens.

                Another consequence is that due to alignment requirements of the watchpoint, the usable stack size
                decreases by up to 60 bytes. This is because the watchpoint region has to be aligned to its size and
                the size for the stack watchpoint in IDF is 32 bytes.

                This check only triggers if the stack overflow writes within 32 bytes near the end of the stack, rather
                than overshooting further, so it is worth combining this approach with one of the other stack overflow
                check methods.

                When this watchpoint is hit, gdb will stop with a SIGTRAP message. When no JTAG OCD is attached,
                esp-idf will panic on an unhandled debug exception.

        config FREERTOS_ENABLE_STATIC_TASK_CLEAN_UP
            bool "Enable static task clean up hook"
            default n
            help
                Enable this option to make FreeRTOS call the static task clean up hook when a task is deleted.

                Note: Users will need to provide a ``void vPortCleanUpTCB ( void *pxTCB )`` callback

        config FREERTOS_CHECK_MUTEX_GIVEN_BY_OWNER
            # This feature is innately supported in FreeRTOS SMP, and hence not available as a config option when
            # FreeRTOS SMP is enabled.
            depends on !FREERTOS_SMP
            bool "Check that mutex semaphore is given by owner task"
            default y
            help
                If enabled, assert that when a mutex semaphore is given, the task giving the semaphore is the task
                which is currently holding the mutex.

        config FREERTOS_ISR_STACKSIZE
            int "ISR stack size"
            range 2096 32768 if ESP_COREDUMP_DATA_FORMAT_ELF
            default 2096 if ESP_COREDUMP_DATA_FORMAT_ELF
            range 1536 32768
            default 1536
            help
                The interrupt handlers have their own stack. The size of the stack can be defined here. Each processor
                has its own stack, so the total size occupied will be twice this.

        config FREERTOS_INTERRUPT_BACKTRACE
            # Todo: Consider removing this. Not sure when users will ever want it to be disabled (IDF-4986)
            bool "Enable backtrace from interrupt to task context"
            default y
            help
                If this option is enabled, interrupt stack frame will be modified to point to the code of the
                interrupted task as its return address. This helps the debugger (or the panic handler) show a backtrace
                from the interrupt to the task which was interrupted. This also works for nested interrupts: higher
                level interrupt stack can be traced back to the lower level interrupt. This option adds 4 instructions
                to the interrupt dispatching code.

        config FREERTOS_FPU_IN_ISR
            bool "Use float in Level 1 ISR"
            depends on IDF_TARGET_ESP32
            default n
            help
                When enabled, the usage of float type is allowed inside Level 1 ISRs. Note that usage of float types in
                higher level interrupts is still not permitted.
    endmenu
endmenu
```
