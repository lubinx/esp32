#include "sdkconfig.h"
/*
    CONFIG_SOC_MEMPROT_CPU_PREFETCH_PAD_SIZE
        fixed = 16

    CONFIG_SOC_MEMPROT_MEM_ALIGN_SIZE
        fixed = 256

    CONFIG_APP_BUILD_USE_FLASH_SECTIONS
        always true
*/
/****************************************************************************
 * sdkconfig.h
*****************************************************************************
*/
    SRAM_TEXT_OVERLAPPED_START =    0x40378000;
    SRAM_ESP_SYSTEM_START =         0x3FCE9710;     /* see appendix */

    ICACHE_SIZE =                   CONFIG_ESP32S3_INSTRUCTION_CACHE_SIZE;
    DCACHE_SIZE =                   CONFIG_ESP32S3_DATA_CACHE_SIZE;

    MMU_PAGE_SIZE =                 0x10000;        /* this is fixed */

#ifdef CONFIG_ULP_COPROC_RESERVE_MEM
    ULP_RESERVED_RTC_SLOW_SIZE =    CONFIG_ULP_COPROC_RESERVE_MEM;
#else
    ULP_RESERVED_RTC_SLOW_SIZE =    0;
#endif

/****************************************************************************
*/

MEMORY
{
    /****************************************************************************
     * internal SRAM
            ref: 4.3.2, table 4-1

        address mapping:
            +--------+-----------------...---------------+----------------+
            | 32K    | 416K data/instruction shared      | 64K            |
            +--------+-----------------...---------------+----------------+
            ^        ^                                   ^
            SRAM0    SRAM1                               SRAM2

        .SRAM0
            0x40370000 => ICACHE, configuratable 16k/32K

        .SRAM1
            416K 0x40378000 ~ 0x403E0000: instruction segment
                OFFSET = 0x6F0000
            416K 0x3FC88000 ~ 0x3FCF0000: data segment

        .SRAM2
            0x3FCF0000 <= DCACHE <= 0x3FD00000, configuratable 16k/32k/64k

        ADDR mapping
            0x40370000 => 32K ICACHE => 0x40378000 => 416K IRAM  => 0x403E0000
                                        0x3FC88000 => 416K DRAM  => 0x3FCF0000 => 64K DCACHE => 0x3FD00000

    ****************************************************************************
    */

    SRAM_data_seg (RW) :            org = 0x3FC88000,   len = 480K
    SRAM_text_seg (RWX) :           org = 0x40370000 + ICACHE_SIZE, len = 448K - ICACHE_SIZE
}
MEMORY
{
    /*
        external FLASH
            // REVIEW: esptool_py hide something in the first 0x20(32 bytes)
    */
    FLASH_data_seg (R) :            org = 0x3C000000 + 0x20,   len = 16M - 0x20
    FLASH_text_seg (X) :            org = 0x42000000 + 0x20,   len = 16M - 0x20

    /*
        PSRAM
    */
    PSRAM_seg (RWX) :               org = 0x3D000000,   len = 16M
}
MEMORY
{
    /*
        RTC
    */
    RTC_slow_seg(RWX) :             org = 0x50000000 + ULP_RESERVED_RTC_SLOW_SIZE, len = 8K - ULP_RESERVED_RTC_SLOW_SIZE
    RTC_fast_seg(RWX) :             org = 0x600FE000,   len = 8K
}
MEMORY
{
    /*
        internal ROM
            ESP system internal use, program able?
    */
    ROM_data_seg (R) :              org = 0x3FF00000,   len = 128K
    ROM_text_seg (RX) :             org = 0x40000000,   len = 384K
}

/****************************************************************************
 *  Memory Usage of ROM 1st bootloader

  -96k      0x3FCD7E00  ------------------> _dram0_0_start
                        |               |
                        |               |
                        |               |   1. Large buffers that are only used in certain boot modes, see shared_buffers.h
                        |               |
                        |               |
  -26864    0x3FCE9710  ------------------> __stack_sentry
    ...                 |               |
      8192              |               |   2. Startup pro cpu stack (freed when IDF app is running)
    ...                 |               |
  -18672    0x3FCEB710  ------------------> __stack (pro cpu)
    ...                 |               |
      8192              |               |      Startup app cpu stack
    ...                 |               |
  -10480    0x3FCED710  ------------------> __stack_app (app cpu)
                        |               |
                        |               |
                        |               |   3. Shared memory only used in startup code or nonos/early boot*
                        |               |      (can be freed when IDF runs)
                        |               |
                        |               |
  -4556     0x3FCEEE34  ------------------> _dram0_rtos_reserved_start
                        |               |
                        |               |
                        |               |   4. Shared memory used in startup code and when IDF runs
                        |               |
                        |               |
  -2192     0x3FCEF770  ------------------> _dram0_rtos_reserved_end
                        |               |
  -2020     0x3FCEF81C  ------------------> _data_start_interface
                        |               |
                        |               |   5. End of DRAM is the 'interface' data with constant addresses (ECO compatible)
                        |               |
   0        0x3FCF0000  ------------------> _data_end_interface

****************************************************************************/
